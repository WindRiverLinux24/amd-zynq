## conf/layer.conf
```bitbake
#
# Copyright (C) 2024 Wind River Systems, Inc.
#

# We have a conf and classes directory, add to BBPATH
BBPATH =. "${LAYERDIR}:"

# We have a packages directory, add to BBFILES
BBFILES += "${LAYERDIR}/recipes-*/*/*.bb \
	${LAYERDIR}/recipes-*/*/*.bbappend"

BBMASK += "${@bb.utils.contains_any('MACHINE', '${BSP_XILINX_DERIVED}', '', '${LAYERDIR}/recipes-bsp/', d)}"

BBFILE_COLLECTIONS += "wr-amd-zynq"
BBFILE_PATTERN_wr-amd-zynq = "^${LAYERDIR}/"
BBFILE_PRIORITY_wr-amd-zynq = "7"

# This should only be incremented on significant changes that will
# cause compatibility issues with other layers
LAYERVERSION_wr-amd-zynq = "1"

LAYERDEPENDS_wr-amd-zynq = "wrlinux core xilinx-tools xilinx"

LAYERSERIES_COMPAT_wr-amd-zynq = "wrl scarthgap"
```

## conf/machine/amd-zynq.conf
```bitbake
#@TYPE: Machine
#@NAME: amd-zynq
#@DESCRIPTION: Machine configuration for AMD Zynq-7000 SoC

DEFAULTTUNE = "cortexa9thf-neon"
WRL_ZYNQ_BOOTBIN_TARGET ?= ""
require ${@bb.utils.contains_any('WRL_ZYNQ_BOOTBIN_TARGET', 'zc702 zc706', 'conf/machine/${WRL_ZYNQ_BOOTBIN_TARGET}-zynq7.conf', 'conf/machine/include/arm/armv7a/tune-cortexa9.inc', d)}
require ${@bb.utils.contains_any('DISTRO_FEATURES', 'ostree', 'conf/machine/zynq-ostree.conf', '', d)}

# To eliminate the annoying output by meta-xilinx-standalone/classes/sanity-meta-xilinx-standalone.bbclass
XILINX_WITH_ESW ?= "xsct"

BSP_XILINX_DERIVED:append = " amd-zynq"

PREFERRED_PROVIDER_virtual/kernel ??= "linux-yocto"
PREFERRED_VERSION_linux-yocto ?= "6.6%"
PREFERRED_VERSION_linux-yocto-rt ?= "6.6%"

KERNEL_DEVICETREE = "xilinx/zynq-zc706.dtb xilinx/zynq-zc702.dtb "

MACHINE_FEATURES = "usbhost jffs2 ext3 pci alsa profile"
#QSPI flash has 64kB erase size
EXTRA_IMAGECMD:jffs2 = "-lnp -e64KiB"

MACHINE_EXTRA_RRECOMMENDS = " kernel-modules kernel-devicetree"
IMAGE_FSTYPES += "tar.bz2 wic wic.bmap"
WKS_FILE = "zynq-sdimage.wks"
IMAGE_INSTALL:append = " kernel-devicetree kernel-image-zimage"
do_image_wic[depends] += "mtools-native:do_populate_sysroot dosfstools-native:do_populate_sysroot"

IMAGE_BOOT_FILES ?= "zImage zynq-zc702.dtb zynq-zc706.dtb"
```

## conf/machine/xilinx-zynq.conf
```bitbake
#@TYPE: Machine
#@NAME: xilinx-zynq
#@DESCRIPTION: Machine configuration for Xilinx Zynq-7000 SoC

DEFAULTTUNE ?= "armv7athf-neon"
require conf/machine/include/arm/armv7a/tune-cortexa9.inc

BSP_XILINX_DERIVED:append = " xilinx-zynq"

PREFERRED_PROVIDER_virtual/kernel ??= "linux-yocto"
PREFERRED_VERSION_linux-yocto ?= "6.1%"
PREFERRED_VERSION_linux-yocto-rt ?= "6.1%"

KERNEL_DEVICETREE = "zynq-zc706.dtb \
                                 zynq-zc702.dtb "

MACHINE_FEATURES = "usbhost jffs2 ext3 pci alsa profile"
#QSPI flash has 64kB erase size
EXTRA_IMAGECMD:jffs2 = "-lnp -e64KiB"

KERNEL_IMAGETYPE = "zImage"

SERIAL_CONSOLE = "115200 ttyPS0"

MACHINE_EXTRA_RRECOMMENDS = " kernel-modules kernel-devicetree"
IMAGE_FSTYPES += "tar.bz2 wic wic.bmap"
WKS_FILE = "zynq-sdimage.wks"
IMAGE_INSTALL:append = " kernel-devicetree kernel-image-zimage"
do_image_wic[depends] += "mtools-native:do_populate_sysroot dosfstools-native:do_populate_sysroot"

# variables needed by xilinx-bootbin package
MACHINEOVERRIDES:prepend = "zynq:"
SOC_FAMILY ?= "zynq"
UBOOT_ELF ?= "u-boot.elf"
UBOOT_MACHINE ?= "xilinx_zynq_virt_defconfig"

IMAGE_BOOT_FILES ?= "zImage zynq-zc702.dtb zynq-zc706.dtb"

# For ostree
# No u-boot
OSTREE_BOOTLOADER_INCLUDE ?= ""
OSTREE_SD_UBOOT_WIC1 ?= ""

INITRAMFS_IMAGE ??= ""
IMAGE_BOOT_FILES:append = " ${@bb.utils.contains('DISTRO_FEATURES', 'ostree', 'boot.scr', '', d)} ${@bb.utils.contains('DISTRO_FEATURES', 'ostree', '${INITRAMFS_IMAGE}-${MACHINE}.${INITRAMFS_FSTYPES};initramfs', '', d)}"

OSTREE_SD_BOOT_ALIGN ?= "4096"
OSTREE_FDISK_BLM ?= "8192"
OSTREE_FDISK_FSZ ?= "132"
OSTREE_KERNEL ?= "zImage"
OSTREE_UBOOT_CMD ?= "bootz"
OSTREE_WKS_EFI_SIZE ?= "--size=64M"
DEFAULT_DTB ?= "zynq-zc706.dtb"
OSTREE_COPY_IMAGE_BOOT_FILES = "1"

OSTREE_BOOTSCR_PRECMD ?= "\
setenv no_menu yes; \
setenv no_setexpr yes; \
setenv loadaddr 0x3000000; \
setenv fdt_addr 0x2a00000; \
setenv initrd_addr 0x6000000; \
setenv console ttyPS0; \
setenv baudrate 115200; \
"

# For ustart.img
OSTREE_NETINST_DEV ?= "/dev/mmcblk0,/dev/sda,/dev/vda"
OSTREE_NETINST_ARGS ?= "${OSTREE_CONSOLE} bl=ufsd rdinit=/install instdev=${OSTREE_NETINST_DEV} instname=wrlinux instbr=\$BRANCH insturl=\$URL instab=${OSTREE_USE_AB} instsf=1 instdate=BUILD_DATE"
```
